## boards/shields/dongle_macropad/Kconfig.shield
```kconfig
config SHILED_DONGLE_MACROPAD
    def_bool $(shields_list_contains,dongle_macropad)
```

## boards/shields/grekorne/Kconfig.defconfig
```kconfig
# SPDX-License-Identifier: MIT

if SHIELD_GREKORNE_DONGLE

config ZMK_KEYBOARD_NAME
	default "Grekorne Dongle"
	
config ZMK_SPLIT_BLE_ROLE_CENTRAL
	default y
	
config ZMK_USB
	default y

config ZMK_BLE_KEYBOARD_PAIRING
	default n

endif

if SHIELD_GREKORNE_LEFT || SHIELD_GREKORNE_RIGHT || SHIELD_GREKORNE_DONGLE 

config ZMK_SPLIT
	default y

config ZMK_BLE
	default y
	
endif
```

## boards/shields/grekorne/Kconfig.shield
```kconfig
# Copyright (c) 2020 Pete Johanson
# SPDX-License-Identifier: MIT

config SHIELD_GREKORNE_LEFT
    def_bool $(shields_list_contains,grekorne_left)

config SHIELD_GREKORNE_RIGHT
    def_bool $(shields_list_contains,grekorne_right)
```
